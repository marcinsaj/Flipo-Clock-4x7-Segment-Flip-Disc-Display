/*-----------------------------------------------------------------------------------------------*
 * 7-Segment Flip-disc Clock by Marcin Saj https://flipo.io                                      *
 * https://github.com/marcinsaj/Flipo-Clock-4x7-Segment-Flip-Disc-Display                        *
 *                                                                                               *
 * Classic 12-hour Clock                                                                         *
 *                                                                                               *
 * Attention!!! - Firmware Update Instructions - https://bit.ly/4x7SEG-CLOCK-FIRMWARE-UPDATE     *
 * Time Setting Instructions - https://bit.ly/4x7SEG-CLOCK-TIME-SET                              *
 *                                                                                               *
 * Setup:                                                                                        *
 * Assembly Instructions - https://bit.ly/Flip-Disc-Clock-Assembly                               *
 * Clock Diagram - https://bit.ly/4x7SEG-CLOCK-DIAGRAM                                           *
 * Dedicated Controller - https://bit.ly/AC1-FD                                                  *
 * 7-Segment Flip-disc Display - https://bit.ly/7SEG-FD                                          *
 * 3x1 Flip-disc Display - https://bit.ly/3x1DOT-FD                                              *
 * Arduino Nano Every - https://bit.ly/ARD-EVERY                                                 *
 * RTC Real Time Clock RX8025T - https://bit.ly/RX8025T                                          *
 * Temperature Sensor DHT22 - https://bit.ly/DHT22                                               *
 *-----------------------------------------------------------------------------------------------*/

#include <FlipDisc.h>         // https://github.com/marcinsaj/FlipDisc
#include <RTC_RX8025T.h>      // https://github.com/marcinsaj/RTC_RX8025T
#include <TimeLib.h>          // https://github.com/PaulStoffregen/Time
#include <Wire.h>             // https://arduino.cc/en/Reference/Wire (included with Arduino IDE)
#include <OneButton.h>        // https://github.com/mathertel/OneButton
#include <EEPROM.h>

/************************************************************************************************/
// Set the delay effect between flip discs. Recommended delay range: 0 - 100ms, max 255ms
uint8_t flip_disc_delay_time = 50;
/************************************************************************************************/

// Attention: do not change! Changing these settings may physical damage the flip-disc displays.
// Pin declaration for a dedicated controller
#define EN_PIN A7  // Start & End SPI transfer data
#define CH_PIN A2  // Charging PSPS module - turn ON/OFF
#define PL_PIN A3  // Release the current pulse - turn ON/OFF 

// RTC
#define RTC_PIN A1 // RTC interrupt input

// Buttons - counting from the top
#define B1_PIN 10  // Top button
#define B2_PIN 9   // Middle button
#define B3_PIN 8   // Bottom button

// Initialize a new OneButton instance for a buttons 
// BUTTON_PIN - Input pin for the button
// false      - Button is active high
// false      - Disable internal pull-up resistor
OneButton button1(B1_PIN, false, false);
OneButton button2(B2_PIN, false, false);
OneButton button3(B3_PIN, false, false);

// The flag to store status of the settings
volatile bool timeSettingsStatus = false;

// Flags for storing button press status
volatile bool shortPressButton1Status = false;
volatile bool longPressButton2Status = false;
volatile bool shortPressButton3Status = false;

// A flag that stores the time display status, if the flag is set, 
// the current time will be displayed
volatile bool timeDisplayStatus = false;

// Declare structure that allows convenient access to the time elements:
// - tm.Hour - hours
// - tm.Minute - minutes
tmElements_t tm;

// An array to store individual digits for display
int digit[4] = {0, 0, 0, 0};
/************************************************************************************************/

void rtcInterruptISR(void)
{
  // Set the status of the flag only if we are not in setting mode
  if(timeSettingsStatus == false) timeDisplayStatus = true; 
}

void setup() 
{
  Serial.begin(9600);

  // Attention: do not change! Changing these settings may physical damage the flip-disc displays.
  // Flip.Pin(...); it is the most important function and first to call before everything else. 
  // The function is used to declare pin functions.
  Flip.Pin(EN_PIN, CH_PIN, PL_PIN);
  
  pinMode(RTC_PIN, INPUT_PULLUP);

  // RTC RX8025T initialization
  RTC_RX8025T.init();

  // Time update interrupt initialization. Interrupt generated by RTC (INT output): 
  // "INT_SECOND" - every second,
  // "INT_MINUTE" - every minute.
  RTC_RX8025T.initTUI(INT_MINUTE);

  // "INT_ON" - turn ON interrupt generated by RTC (INT output),
  // "INT_OFF" - turn OFF interrupt.
  RTC_RX8025T.statusTUI(INT_ON);
  
  // ssign an interrupt handler to the RTC output, 
  // an interrupt will be generated every minute to display the time
  attachInterrupt(digitalPinToInterrupt(RTC_PIN), rtcInterruptISR, FALLING);

  // Attention: do not change! Changing these settings may physical damage the flip-disc displays. 
  // Flip.Init(...); it is the second most important function. Initialization function for a series 
  // of displays. The function also prepares SPI to control displays. Correct initialization requires 
  // code names of the serially connected displays:
  // - D7SEG - 7-segment display
  // - D3X1 - 3x1 display
  Flip.Init(D7SEG, D7SEG, D3X1, D7SEG, D7SEG);

  // Function allows you to control one, two or three discs of the selected D3X1 display.
  // - Flip.Display_3x1(module_number, disc1, disc2, disc3);
  Flip.Display_3x1(1, 0,0,0);

  // his function allows you to display numbers and symbols
  // Flip.Matrix_7Seg(data1,data2,data3,data4); 
  Flip.Matrix_7Seg(F,L,I,P);
  delay(1500);
  Flip.Matrix_7Seg(D,I,S,C);
  delay(1500);

  // The function is used to turn off (clear) all displays
  Flip.Clear();

  // Link the button 1 function
  button1.attachClick(ShortPressButton1);

  // Link the button 2 function
  button2.attachLongPressStart(LongPressButton2);

  // Link the button 3 function
  button3.attachClick(ShortPressButton3);

  Serial.println("Flip-disc 7-Segment Clock");

  DisplayTime();
}

void loop(void)
{
  WatchButtons();

  if(timeDisplayStatus == true) DisplayTime();
  if(timeSettingsStatus == true) SettingTime();
}

void DisplayTime(void)
{
  // The function is used to set the delay effect between flip discs. 
  // The default value without calling the function is 0. Can be called multiple times 
  // anywhere in the code. Recommended delay range: 0 - 100ms, max 255ms */
  Flip.Delay(flip_disc_delay_time);
  
  // Get the time from the RTC and save it to the tm structure
  RTC_RX8025T.read(tm);
  
  uint8_t hour_time = tm.Hour;
  uint8_t minute_time = tm.Minute;

  /* 12-Hour conversion */
  if(hour_time > 12) hour_time = hour_time - 12;
  if(hour_time == 0) hour_time = 12; 
  
  /* Extract individual digits for the display */
  digit[0] = (hour_time / 10) % 10;
  digit[1] = (hour_time / 1) % 10;
  digit[2] = (minute_time / 10) % 10;
  digit[3] = (minute_time / 1) % 10;

  // Display the current time
  Flip.Display_3x1(1, 1,1,0);
  Flip.Matrix_7Seg(digit[0],digit[1],digit[2],digit[3]);
  
  // Print time to the serial monitor
  Serial.print("Time: ");
  if(tm.Hour < 10) Serial.print("0");
  Serial.print(tm.Hour);
  Serial.print(":");
  if(tm.Minute < 10) Serial.print("0");
  Serial.println(tm.Minute);

  // The delay effect is used only when displaying time 
  // During time settings, the delay is 0
  Flip.Delay(0);

  // Clear the flag
  timeDisplayStatus = false;
}

void SettingTime(void)
{
  ClearPressButtonFlags();

  uint8_t time_settings_level = 1;
  
  Flip.Display_3x1(1, 0,0,0); // Clear the dots
  Flip.Matrix_7Seg(T,I,M,E);
  delay(1500);
  
  // Display the first digit to set
  Flip.Matrix_7Seg(digit[0],HLM,HLM,HLM);

  // Stay in the time settings until all digits are set
  do
  {
    WatchButtons();
    
    if(shortPressButton1Status == true || shortPressButton3Status == true)
    {
      uint8_t digit_number = time_settings_level - 1;

      // Top button "+1", bottom button "-1"
      if(shortPressButton1Status == true) {digit[digit_number] = digit[digit_number] + 1;}
      if(shortPressButton3Status == true) {digit[digit_number] = digit[digit_number] - 1;}

      // First digit: 0-1
      if(time_settings_level == 1)
      {
        if(digit[digit_number] < 0) digit[digit_number] = 1;
        if(digit[digit_number] > 1) digit[digit_number] = 0;
      }
    
      // Second digit: 0-9
      if(time_settings_level == 2)
      {
        // If the first digit is 0 then the second digit can be from 0 to 9
        if(digit[digit_number-1] == 0)
        {
          if(digit[digit_number] < 0) digit[digit_number] = 9;
          if(digit[digit_number] > 9) digit[digit_number] = 0;
        }

        // If the first digit is 1 then the second digit 
        // cannot be greater than 2 because the largest possible hour is 12
        if(digit[digit_number-1] == 1)
        {
          if(digit[digit_number] > 2) digit[digit_number] = 0;
          if(digit[digit_number] < 0) digit[digit_number] = 2;
        }
      }

      // Third digit: 0-5
      if(time_settings_level == 3)
      {
        if(digit[digit_number] < 0) digit[digit_number] = 5;
        if(digit[digit_number] > 5) digit[digit_number] = 0;
      }     

      // Fourth digit: 0-9
      if(time_settings_level == 4)
      {
        if(digit[digit_number] < 0) digit[digit_number] = 9;
        if(digit[digit_number] > 9) digit[digit_number] = 0;
      }

      // Update the display for only the currently set digit,
      // for more details see FlipDisc.h library
      Flip.Display_7Seg(time_settings_level, digit[time_settings_level - 1]);  

      ClearPressButtonFlags();
    }

    if(longPressButton2Status == true)
    {
      time_settings_level = time_settings_level + 1;
      if(time_settings_level > 4) time_settings_level = 0;

      // If the first digit is 1 then the second digit 
      // cannot be greater than 2, because the largest possible hour is 12.
      // It may happen that the original time was set to e.g. 09:00, 
      // so when setting the time it could happen that in the 12-hour format
      // we would have the time incorrectly set to 19:00.
      // Therefore, if the first digit is 1 and the second digit 
      // of the old set time is greater than 2, it will be set to 0 by default
      if(time_settings_level == 2) 
      {
        if(digit[0] == 1 && digit[1] > 2) digit[1] = 0; 
        Flip.Matrix_7Seg(HLM,digit[1],HLM,HLM);
      }

      if(time_settings_level == 3) Flip.Matrix_7Seg(HLM,HLM,digit[2],HLM);
      if(time_settings_level == 4) Flip.Matrix_7Seg(HLM,HLM,HLM,digit[3]);
    
      ClearPressButtonFlags();
    }
  } while(time_settings_level != 0); // Stay in the time settings until all digits are set
  
  // Convert entered individual digits to the format supported by RTC
  uint8_t hour_time = (digit[0] * 10) + digit[1];
  uint8_t minute_time = (digit[2] * 10) + digit[3];

  // setTime(hh, mm, ss, day, month, year) 
  // The date is skipped and the seconds are set by default to 0
  // We are only interested in hours and minutes
  setTime(hour_time, minute_time, 0, 0, 0, 0);

  // Set the RTC from the system time
  RTC_RX8025T.set(now());
  
  timeSettingsStatus = false;
  timeDisplayStatus = true;
}

// Button flags clearing function
void ClearPressButtonFlags(void)
{
  shortPressButton1Status = false;
  longPressButton2Status = false;
  shortPressButton3Status = false;
}

// Keep watching the buttons
void WatchButtons(void)
{
  button1.tick();
  button2.tick();
  button3.tick();

  // If the time settings are not currently active and a long press of the middle button is detected, 
  // set the time settings flag
  if(timeSettingsStatus == false && longPressButton2Status == true) timeSettingsStatus = true;
}

// Button press handling functions
void ShortPressButton1(void){shortPressButton1Status = true;}
void LongPressButton2(void){longPressButton2Status = true;}
void ShortPressButton3(void){shortPressButton3Status = true;}
